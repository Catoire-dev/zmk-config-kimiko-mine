#include <dt-bindings/zmk/matrix_transform.h>
#include <physical_layouts.dtsi>

#include "kimiko_mine.dtsi"


/ {
    default_kscan: kscan {
        compatible = "zmk,kscan-gpio-matrix";
        diode-direction = "col2row";
        
        col-gpios = <&pro_micro 9 GPIO_ACTIVE_HIGH>,
                    <&pro_micro 8 GPIO_ACTIVE_HIGH>,
                    <&pro_micro 7 GPIO_ACTIVE_HIGH>,
                    <&pro_micro 6 GPIO_ACTIVE_HIGH>,
                    <&pro_micro 5 GPIO_ACTIVE_HIGH>,
                    <&pro_micro 4 GPIO_ACTIVE_HIGH>,
                    <&pro_micro 3 GPIO_ACTIVE_HIGH>;
    };
};