#include <dt-bindings/zmk/matrix_transform.h>
#include <physical_layouts.dtsi>

#include "kimiko_mine.dtsi"


/ {
	default_kscan: kscan {
		compatible = "zmk,kscan-gpio-matrix";
		diode-direction = "col2row";
		
		col-gpios = <&pro_micro 10 GPIO_ACTIVE_HIGH>,
					<&pro_micro 16 GPIO_ACTIVE_HIGH>,
					<&pro_micro 14 GPIO_ACTIVE_HIGH>,
					<&pro_micro 15 GPIO_ACTIVE_HIGH>,
					<&pro_micro 18 GPIO_ACTIVE_HIGH>,
					<&pro_micro 19 GPIO_ACTIVE_HIGH>,
					<&pro_micro 20 GPIO_ACTIVE_HIGH>;
	};

	default_transform: matrix_transform_0 {
		col-offset = <7>;
	};

};